## arch/arm/src/nrf53/Kconfig
```kconfig
#
# For a description of the syntax of this configuration file,
# see the file kconfig-language.txt in the NuttX tools repository.
#

comment "NRF53 Configuration Options"

choice
	prompt "NRF53 Chip Selection"
	default ARCH_CHIP_NRF5340
	depends on ARCH_CHIP_NRF53

config ARCH_CHIP_NRF5340
	bool "NRF5340"

endchoice # NRF53 Chip Selection

# NRF53 Families


choice
	prompt "NRF5340 Core Selection"
	default ARCH_CHIP_NRF5340_CPUAPP
	depends on ARCH_CHIP_NRF5340

config ARCH_CHIP_NRF5340_CPUAPP
	bool "NRF53 App core"

config ARCH_CHIP_NRF5340_CPUNET
	bool "NRF53 Net core"

endchoice # NRF5340 Core Selection

if NRF53_APPCORE

config NRF53_NET_BOOT
	bool "NRF53 Net core configuration"
	default y

if NRF53_NET_BOOT

config NRF53_NET_POWER_ON_BOOT
	bool "NRF53 Power Net core on App core boot"
	default y

config NRF53_NET_GPIO_ALLOW_ALL
	bool "NRF53 allow all GPIO for Net core"
	default y

endif # NRF53_NET_BOOT

endif # NRF53_APPCORE

# Peripheral Selection

config NRF53_UART
	bool
	default n

menu "NRF53 Peripheral Selection"

config NRF53_UART0
	bool "UART0"
	default n
	select UART0_SERIALDRIVER
	select NRF53_UART

config NRF53_UART1
	bool "UART1"
	default n
	select UART1_SERIALDRIVER
	select NRF53_UART

endmenu # NRF53 Peripheral Selection
```

## arch/arm64/src/vdk/Kconfig
```kconfig
#
# For a description of the syntax of this configuration file,
# see the file kconfig-language.txt in the NuttX tools repository.
#

if ARCH_CHIP_VDK

menu "VDK Virt Chip Selection"

choice
	prompt "VDK Core Configuration"
	default ARCH_CHIP_VDK_R82

config ARCH_CHIP_VDK_R82
	bool "VDK virtual Processor (cortex-r82)"
	select ARCH_HAVE_MULTICPU
	select ARMV8R_HAVE_GICv3
	select ARCH_SET_VMPIDR_EL2

endchoice # VDK Chip Selection

endmenu # "VDK Chip Selection"

menu "VDK Peripheral Selection"
config VDK_UART_16550
	bool "UART"
	default n
	select UART1_SERIALDRIVER
endmenu # VDK Peripheral Selection

endif # ARCH_CHIP_VDK
```

## drivers/sysevent/Kconfig
```kconfig
#
# For a description of the syntax of this configuration file,
# see the file kconfig-language.txt in the NuttX tools repository.
#

menuconfig SYSEVENT
	bool "Sysevent Driver Support"
	default n
	---help---
		This selection enables selection of common sysevent options. This
		option is enabled to support report sysevent.

if SYSEVENT

config SYSEVENT_DEV_PATH
	string "Sysevent Path"
	default "/dev/sysevent"

config SYSEVENT_DEV_FIFO_SIZE
	int "Sysevent device fifo buffer size"
	default 1024

endif # SYSEVENT
```

## drivers/virtio/Kconfig
```kconfig
#
# For a description of the syntax of this configuration file,
# see the file kconfig-language.txt in the NuttX tools repository.
#

menuconfig DRIVERS_VIRTIO
	bool "Virtio Device Support"
	depends on OPENAMP
	default n

if DRIVERS_VIRTIO
config DRIVERS_VIRTIO_MMIO
	bool "Virtio MMIO Device Support"
	default n

config DRIVERS_VIRTIO_MMIO_QUEUE_LEN
	int "Virtio MMIO Virtio Queue Length"
	default 0
	range 0 1024
	depends on DRIVERS_VIRTIO_MMIO
	---help---
		If this value equals to 0, use the max queue length get from
		mmio register.

config DRIVERS_VIRTIO_BLK
	bool "Virtio block support"
	default n

config DRIVERS_VIRTIO_NET
	bool "Virtio network support"
	default n
	select ARCH_HAVE_NETDEV_STATISTICS
	select NETDEV_LATEINIT

config DRIVERS_VIRTIO_RNG
	bool "Virtio rng support"
	default n
	select ARCH_HAVE_RNG

config DRIVERS_VIRTIO_SERIAL
	bool "Virtio serial support"
	default n
	select SERIAL_RXDMA
	select SERIAL_TXDMA

if DRIVERS_VIRTIO_SERIAL
config DRIVERS_VIRTIO_SERIAL_BUFSIZE
	int "Virtio serial driver buffer size"
	default 256
endif
endif # DRIVERS_VIRTIO
```
